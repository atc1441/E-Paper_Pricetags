#include <Arduino.h>
#include "RFV3.h"
#include "cc1101_spi.h"
#include "cc1101.h"
#include "logger.h"
#include "main_variables.h"

uint8_t cc1101_frequency_list[219] = {
  0x21, 0x63, 0xF0, 0x21, 0x66, 0xE4, 0x21, 0x6B, 0xD0, 0x21, 0x71, 0x7A,
  0x21, 0x74, 0xAD, 0x21, 0x33, 0x33, 0x21, 0x37, 0x23, 0x21, 0x3B, 0x13,
  0x21, 0x3F, 0x03, 0x21, 0x42, 0xF4, 0x22, 0xB6, 0x27, 0x22, 0xBB, 0x13,
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  0x23, 0x61, 0xF8
};

int curr_freq = -1;
int curr_net_id = -1;

bool init_radio() {
  log_verbose("Radio init");
  digitalWrite(SS_PIN, LOW);
  delayMicroseconds(10);
  digitalWrite(SS_PIN, HIGH);
  delayMicroseconds(40);
  spi_write_strobe(0x30);
  delay(1);

  uint8_t version_cc1101 = spi_read_register(0xF1);
  log_verbose("Radio version: " + String(version_cc1101));
  if (version_cc1101 == 0x00 || version_cc1101 == 0xFF) {
    log_verbose("Radio not working!!!");
    return false;
  }

  spi_write_register(0x00, 0x02);//IOCFG2
  spi_write_register(0x02, 0x0E);//IOCFG0
  spi_write_register(0x03, 0x0E);//FIFOTHR
  spi_write_register(0x06, 0xFF);//PKTLEN
  spi_write_register(0x07, 0x0E);//PKTCTRL1
  spi_write_register(0x08, 0x05);//PKTCTRL0
  spi_write_register(0x09, 0x01);//ADDR
  spi_write_register(0x0a, 0x00);//CHANNR
  spi_write_register(0x0B, 0x06);//FSCTRL1
  spi_write_register(0x0C, 0x00);//FSCTRL0
  spi_write_register(0x10, 0xCA);//MDMCFG4
  spi_write_register(0x11, 0x83);//MDMCFG3
  spi_write_register(0x12, 0x13);//MDMCFG2
  spi_write_register(0x13, 0x22);//MDMCFG1
  spi_write_register(0x14, 0xf8);//MDMCFG0
  spi_write_register(0x15, 0x34);//DEVIATN
  spi_write_register(0x17, 0x3E);//MCSM1
  spi_write_register(0x18, 0x08);//MCSM0
  spi_write_register(0x19, 0x16);//FOCCFG
  spi_write_register(0x1a, 0x6c);//BSCFG
  spi_write_register(0x1B, 0x43);//AGCTRL2
  spi_write_register(0x1C, 0x4B);//AGCTRL1
  spi_write_register(0x1D, 0x91);//AGCTRL0
  spi_write_register(0x21, 0x56);//FREND1
  spi_write_register(0x22, 0x10);//FREND0
  spi_write_register(0x23, 0xE9);//FSCAL3
  spi_write_register(0x24, 0x2A);//FSCAL2
  spi_write_register(0x25, 0x00);//FSCAL1
  spi_write_register(0x26, 0x1F);//FSCAL0
  spi_write_register(0x29, 0x59);//FSTEST
  spi_write_register(0x2C, 0x81);//TEST2
  spi_write_register(0x2D, 0x35);//TEST1
  spi_write_register(0x2E, 0x09);//TEST0
  spi_write_register(0x3E, 0x00);//PATABLE

  spi_write_strobe(0x3B);//Clear RX buffer
  spi_write_strobe(0x3A);//Clear TX buffer

  CC1101_set_freq(get_wu_channel());

  spi_write_register(0x3E, 0xC2);//PATABLE
  log_verbose("Radio init done");
  return true;
}

void CC1101_set_freq(uint8_t freq) {
  uint8_t *s = (uint8_t *)&cc1101_frequency_list[(3 * freq)];
  if (freq >= 73) {
    log_normal("ERROR: Freq too high " + String(freq));
    return;
  }
  if (curr_freq != freq) {
    curr_freq = freq;
    spi_write_strobe(0x36);
    spi_write_register(0xD, s[0]);
    spi_write_register(0xE, s[1]);
    spi_write_register(0xF, s[2]);
  }
  uint32_t IF = (s[0] << 16) + (s[1] << 8) + s[2]; // 24-bit value
  float f = (26000000.0f / 65536.0f) * (float)(IF);
  log_verbose("Radio set to base freq: (F=" + String(freq) + ") " + String(f/1000000.0f) + " Mhz ");
//  log_verbose("Radio set freq done " + String(cc1101_frequency_list[(3 * freq) + 0]) + " " + String(cc1101_frequency_list[(3 * freq) + 1]) + " " + String(cc1101_frequency_list[(3 * freq) + 2]) + " ");
}

void CC1101_set_net_id(uint8_t id) {
  if (curr_net_id != id) {
    curr_net_id = id;
    spi_write_register(0x09, id);
  }
  log_verbose("Radio set id done " + String(id));
}

void set_fifo_interrupt(uint8_t first, uint8_t third) {
  spi_write_register(0x00, first);
  spi_write_register(0x03, third);
}

void cc1101_idle() {
  spi_write_strobe(0x36);
  spi_write_strobe(0x3B);
  spi_write_strobe(0x3A);
}

void cc1101_rx() {
  spi_write_strobe(0x34);
}

void cc1101_tx() {
  spi_write_strobe(0x35);
}

void cc1101_prepaire_tx() {

  spi_write_register(0x07, 0x0E);
  spi_write_register(0x17, 0x32);

  cc1101_idle();

  spi_write_register(0x07, 0x0E);
  spi_write_register(0x17, 0x02);

  set_fifo_interrupt(6, 7);

  long last_100_millis = millis();
  while (millis() - last_100_millis < 100) {
    spi_write_strobe(0x3B);
  }
  cc1101_idle();
  spi_write_strobe(0x33);

  long temp_timeout_time = millis();
  uint8_t temp_read_cali;
  while (temp_read_cali != 1) {
    temp_read_cali = spi_read_register(0xF5);
    if (millis() - temp_timeout_time > 250) {
      log_normal("Timeout radio calibration 1");
      break;
    }
  }
  spi_write_strobe(0x34);
  set_fifo_interrupt(6, 7);
  temp_timeout_time = millis();
  while (temp_read_cali != 0x0D) {
    temp_read_cali = spi_read_register(0xF5);
    if (millis() - temp_timeout_time > 250) {
      log_normal("Timeout radio calibration 2");
      break;
    }
  }
  while (millis() - last_100_millis < 102) {}
}

void cc1101_end_tx() {
  set_fifo_interrupt(6, 7);
  cc1101_idle();
}
